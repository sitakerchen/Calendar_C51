/**********************************************************/
/*******************************************************************
*                                                                  *
* 文件： LCD1602.c                                                     *
*                                                                  *
* 作者： gguoqing, cxl Hunau                                                 *
* 网站： www.willar.com(伟纳电子)                                  *
* 邮箱： gguoqing@willar.com                                       *
*                                                                  *
*【版权】Copyright(C)伟纳电子 www.willar.com  All Rights Reserved  *
*【声明】此程序仅用于学习与参考，引用请注明版权和作者信息！        *
*                                                                  *
********************************************************************/
#include <reg52.h>
#include <intrins.h>
#include <LCD1602.h>
#define delayNOP(); {_nop_();_nop_();_nop_();_nop_();};
#define OUT P2
sbit LCD_RS = P1^6;             
sbit LCD_RW = P1^5;
sbit LCD_EN = P1^4;
/**********************************************************
延时子程序
**********************************************************/
void delayms(uint ms) 
{
  uchar k;
  while(ms--)
  {
    for(k = 0; k < 110; k++);
  }
}
/**********************************************************
  检查LCD忙状态               
  lcd_busy为1时,忙，等待。
  lcd-busy为0时,闲，可写指令与数据。      
                                                        
**********************************************************/ 
bit lcd_busy()
{                          
   bit result;
   LCD_RS = 0;
   LCD_RW = 1;
   LCD_EN = 1;
   delayNOP();
   result = (bit)(OUT&0x80);
   LCD_EN = 0;
   return(result); 
}
/**********************************************************
  写指令数据到LCD                                                
  RS=L，RW=L，E=高脉冲，D0-D7=指令码。                             
                                                                
**********************************************************/
void lcd_wcmd(uchar cmd)
{                          
   while(lcd_busy());
   LCD_RS = 0;
   LCD_RW = 0;
   LCD_EN = 0;
   _nop_();
   _nop_(); 
   OUT = cmd;
   delayNOP();
   LCD_EN = 1;
   delayNOP();
   LCD_EN = 0;  
}
/**********************************************************
  写显示数据到LCD                                                
  RS=H，RW=L，E=高脉冲，D0-D7=数据。                            
                                                                
**********************************************************/
void lcd_wdat(uchar dat)
{                          
   while(lcd_busy());
   LCD_RS = 1;
   LCD_RW = 0;
   LCD_EN = 0;
   OUT = dat;
   delayNOP();
   LCD_EN = 1;
   delayNOP();
   LCD_EN = 0; 
}
/**********************************************************
  LCD初始化设定                                                
                                                                 
**********************************************************/
void lcd_init()
{ 
   delayms(15);                   
   lcd_wcmd(0x38);      //16*2显示，5*7点阵，8位数据
   delayms(5);
   lcd_wcmd(0x38);         
   delayms(5);
   lcd_wcmd(0x38);         
   delayms(5);
   lcd_wcmd(0x0c);      //显示开，关光标
   delayms(5);
   lcd_wcmd(0x06);      //移动光标, 与教材有差异，教材上为05，此处原为06
   delayms(5);
   lcd_wcmd(0x01);      //清除LCD的显示内容
   delayms(5);
}
/**********************************************************
  设定显示位置                                                 
                                                               
***********************************************************/
void lcd_pos(uchar pos)
{                          
   lcd_wcmd(pos | 0x80);  //数据指针=80+地址变量
}
/*********************************************************/
/**********************************************************
输出显示字符串，且指针增1
**********************************************************/
void lcd_disString(uchar ad, uchar *s, uint ifDelay)
{
 	lcd_wcmd(ad);
	while (*s > 0)
	{
	 	lcd_wdat(*s++);
		if (ifDelay) delayms(100);
	}
}
/**********************************************************/